## bscapp/Kconfig
```kconfig
#
# For a description of the syntax of this configuration file,
# see misc/tools/kconfig-language.txt.
#

menu "BS Controller Specific"

config BSCAPP
	bool "BS Controller Application"
	default n
	---help---
		Activate BS Controller application.

endmenu
```

## examples/bscapp/Kconfig
```kconfig
#
# For a description of the syntax of this configuration file,
# see misc/tools/kconfig-language.txt.
#

if NETUTILS_MQTT

config BSCAPP
	bool "BS Controller Application"
	default n
	---help---
		Activate BS Controller application.

endif
```

## examples/relays/Kconfig
```kconfig
#
# For a description of the syntax of this configuration file,
# see the file kconfig-language.txt in the NuttX tools repository.
#

config EXAMPLES_RELAYS
	bool "Relay Example"
	default n
	---help---
		Enable the relay example.

if EXAMPLES_RELAYS

config EXAMPLES_RELAYS_NRELAYS
	int "Number of Relays"
	default 2

endif
```

## neuron/Kconfig
```kconfig
#
# For a description of the syntax of this configuration file,
# see misc/tools/kconfig-language.txt.
#

menu "Neuron Application"

config NEURON
	bool "Support Neuron Application"
	default n
	---help---
		This application is part of Linkgo Neural System.
		It access the Neurite via UART in order to exchange information
		with other nodes (may be Neurons).
		For more details, please refer to:

		http://linkgo.io

if NEURON

config NEURON_DISPLAY_VPLANE
	int "Video Plane"
	default 0
	---help---
		The plane to select from the framebuffer driver for use in the test.
		Default: 0

config NEURON_DISPLAY_DEVNO
	int "Video Device Number"
	default 0
	---help---
		The LCD device to select from the LCD driver for use in the test:
		Default: 0

config NEURON_DISPLAY_BPP
	int "Bits-Per-Pixel"
	default 32
	---help---
		Pixels per pixel to use.  Valid options include 1, 2, 4, 8, 16, 24,
		and 32.  Default is 32.


comment "Example Color Configuration"

config NEURON_DISPLAY_DEFAULT_COLORS
	bool "Use Default Colors"
	default y

if !NEURON_DISPLAY_DEFAULT_COLORS

config NEURON_DISPLAY_BGCOLOR
	hex "Background color"
	default 0x0
	---help---
		The color of the background.  Default depends on config
		NEURON_DISPLAY_BPP.

config NEURON_DISPLAY_FONTCOLOR
	hex "Background font color"
	default 0x0
	---help---
		The color of the fonts used in the background window. Default
		depends on config NEURON_DISPLAY_BPP.

endif

comment "Example Font Configuration"

config NEURON_DISPLAY_DEFAULT_FONT
	bool "Use Default Font"
	default y

if !NEURON_DISPLAY_DEFAULT_FONT

config NEURON_DISPLAY_FONTID
	int "Background font ID"
	default 0
	---help---
		Selects the font used in the background window (see font ID numbers
		in include/nuttx/nx/nxfonts.h)

endif

config NEURON_DISPLAY_EXTERNINIT
	bool "External Device Initialization"
	default n
	depends on LIB_BOARDCTL
	select BOARDCTL_GRAPHICS
	---help---
		The driver for the graphics device on this platform requires some
		unusual initialization.  This is the case, for example, for SPI LCD/OLED
		devices.  If this configuration is selected, then the platform code
		must provide an LCD initialization function with a prototype like:

		#ifdef CONFIG_NX_LCDDRIVER
		FAR struct lcd_dev_s *board_graphics_setup(unsigned int devno);
		#else
		FAR struct fb_vtable_s *board_graphics_setup(unsigned int devno);
		#endif

		and must also define: CONFIG_LIB_BOARDCTL=y and
		CONFIG_BOARDCTL_GRAPHICS=y so that the boardctl() interface
		will be available in order to access this function.

endif

endmenu
```
